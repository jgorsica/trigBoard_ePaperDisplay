String rapidApiKey = "addYourRapidApiKeyHere";
String accuweatherKey = "addYourAccuweatherApiKeyHere";
char* substr(char* arr, int begin, int len){
  char* res = new char[len + 1];
  for (int i = 0; i < len; i++)
    res[i] = *(arr + begin + i);
  res[len] = 0;
  return res;
}

struct HourlyWeatherData {
  String dateTime = "2022-06-21T23:00:00-05:00";
  int weatherIcon = 1;
  bool isDaylight = true;
  int temperature = 70;
  int uvIndex = 5;
  int precipitationProbability = 20;
};
struct DailyWeatherData {
  String dayDescription = "Day weather description goes here";
  String nightDescription = "Night weather description goes here";
  int airQuality = 0;
  int grass = 2;
  int mold = 3;
  int ragweed = 2;
  int tree = 3;
  int uvIndex = 0;
};

void setFont(int fontSize){
  const GFXfont* f;
  if(fontSize==6){
      display.setTextSize(1);
      f = NULL;
    } else if(fontSize==9){
      display.setTextSize(1);
      f = &FreeMonoBold9pt7b;
    } else if(fontSize==12){
      display.setTextSize(1);
      f = &FreeMonoBold12pt7b;
    } else if(fontSize==18){
      display.setTextSize(1);
      f = &FreeMonoBold18pt7b;
    } else if(fontSize==24){
      display.setTextSize(1);
      f = &FreeMonoBold24pt7b;
    } else if(fontSize==36){
      display.setTextSize(2);
      f = &FreeMonoBold18pt7b;
    } else if(fontSize==48){
      display.setTextSize(2);
      f = &FreeMonoBold24pt7b;
    } else {
      display.setTextSize(1);
      f = NULL;
    }
    display.setFont(f);
}

//Given a single line of text, the font size, and the maximum number of lines, 
//tries to split the text to be displayed in the given width and updates the number of lines allowed to the number of lines needed.
bool getLinesFromText(String* lines, int &lineCount, String text, int fontSize, int boundingWidth){
  int16_t boundX;
  int16_t boundY; 
  uint16_t boundW; 
  uint16_t boundH;
  for (int lineNumber = 0; lineNumber<lineCount; lineNumber++){lines[lineNumber]="";}
  int lineStart = 0;
  int space = 0;
  int nextSpace = 0;
  for (int lineNumber = 0; lineNumber<lineCount; lineNumber++){
    boundW = 0;
    while(boundW < boundingWidth){
      space = nextSpace;
      nextSpace = text.indexOf(' ', space + 1);
      if(nextSpace==-1){
        display.getTextBounds(text.substring(lineStart,text.length()), 0, 0, &boundX, &boundY, &boundW, &boundH);
        if(boundW < boundingWidth){
          lines[lineNumber] = text.substring(lineStart,text.length());
          lineCount = lineNumber + 1;
          return true;
        } else{
          break;
        }
      }
      display.getTextBounds(text.substring(lineStart,nextSpace), 0, 0, &boundX, &boundY, &boundW, &boundH);
    }
    lines[lineNumber] = text.substring(lineStart,space);
    if(text.substring(space,space+1).equals(" ")){ //single word fits on line, remove space
      lineStart = space + 1;
    } else { //single word too big for line, don't remove first letter
      lineStart = space;
    }
    space = lineStart;
    nextSpace = space;
  }
  return false;
}

bool getLinesAndFontThatFit(String* lines, int &lineCount, int &fontSize, String text, int myFontSizes[], int numberOfFontSizes, int boundingWidth, int boundingHeight){
  //loop through font sizes, use the first one where the text fits
  for (int i = 0; i < numberOfFontSizes; i++){
    lineCount = boundingHeight/(myFontSizes[i]*1.667);
    setFont(myFontSizes[i]);
    if (getLinesFromText(lines, lineCount, text, myFontSizes[i], boundingWidth)){
      fontSize = myFontSizes[i];
      Serial.print("Good font size:");
      Serial.println(fontSize);
      Serial.print("Text:");
      Serial.println(text);
      Serial.print("linecount:");
      Serial.println(lineCount);
      return true;
    }
  }
  Serial.println("Text too long to display in bounding rectangle.");
  return false; //saying too long
}

//Given an array of lines of text, the font size, the box to display the text in, and the justifications for layout, will add text to the display
void addTextToDisplay(String* lines, int lineCount, int fontSize, int left, int top, int boundingWidth, int boundingHeight, int justifyH, int justifyV){
  int textHeight = fontSize * 1.667;
  int16_t boundX;
  int16_t boundY; 
  uint16_t boundW; 
  uint16_t boundH;
  int leftOfLine = left;
  int topOfBlock = top;
  if (justifyV == 0){
    topOfBlock = top + (boundingHeight/2) - (textHeight*lineCount)/2;
  } else if (justifyV == 1){
    topOfBlock = top + boundingHeight - (textHeight*lineCount);
  }
  for(int i = 0; i<lineCount; i++){
    if (justifyH == 0){
      display.getTextBounds(lines[i], 0, 0, &boundX, &boundY, &boundW, &boundH);
      leftOfLine = left + boundingWidth/2 - boundW/2;
    } else if (justifyH == 1){
      display.getTextBounds(lines[i], 0, 0, &boundX, &boundY, &boundW, &boundH);
      leftOfLine = left + boundingWidth - boundW;
    }
    display.setCursor(leftOfLine,topOfBlock+textHeight-int(fontSize*0.334)+i*textHeight);
    //Serial.println(lines[i]);
    display.println(lines[i]);
  }
}

bool getChuckNorrisSaying(String &chuckSaying, String &none, WiFiClientSecure *client){
  if (client->connect("matchilling-chuck-norris-jokes-v1.p.rapidapi.com", 443)) {
    Serial.println("connected to server...");

    String http = String("GET /jokes/random HTTP/1.1\r\nAccept: application/json\r\nX-Rapidapi-Host: matchilling-chuck-norris-jokes-v1.p.rapidapi.com\r\nX-Rapidapi-Key: ")+rapidApiKey+String("\r\nHost: matchilling-chuck-norris-jokes-v1.p.rapidapi.com\r\n\r\n");
    client->print(http);
    Serial.println("requesting...");
    //let's wait for something to come back... only a few seconds
    unsigned long startTime = millis();
    while (millis() - startTime < 5000) {
      if (client->available()) {
        Serial.println("From Server");
        break;
      }
    }
    delay(1000);
    client->readStringUntil('{');
    client->readStringUntil('{');
    client->readStringUntil('{');
    client->readStringUntil('{');
    String jsonData = "{";
    
    startTime = millis();
    while (millis() - startTime < 1000) {
      if (client->available()) {
        jsonData.concat(char(client->read()));
        startTime = millis();
      }
    }
    client->stop();
    
    Serial.println(jsonData);
    //https://arduinojson.org/v6/assistant/
    DynamicJsonDocument doc(1024);
    DeserializationError error = deserializeJson(doc, jsonData);
    if (error) {
      Serial.print("deserializeJson() failed: ");
      Serial.println(error.c_str());
      return false;
    }
    String result = doc["value"];
    chuckSaying = result;
    chuckSaying.replace("\n","...");

    Serial.print("Chuck Norris: ");
    Serial.println(chuckSaying);
    return true;
  } else {
    Serial.println("Didn't connect to api server.");
    return false;
  }
}

bool getQuote(String &quote, String &person, WiFiClientSecure *client){
  if (client->connect("motivational-quotes1.p.rapidapi.com", 443)) {
    Serial.println("connected to server...");
    
    String http = String("POST /motivation HTTP/1.1\r\nContent-Type: application/json\r\nX-Rapidapi-Host: motivational-quotes1.p.rapidapi.com\r\nX-Rapidapi-Key: ")+rapidApiKey+String("\r\nHost: motivational-quotes1.p.rapidapi.com\r\nContent-Length: 50\r\n\r\n{\r\n    \"quote\": \"value\",\r\n    \"person\": \"value\"\r\n}\r\n\r\n");
    client->print(http);
    Serial.println("requesting...");
    //let's wait for something to come back... only a few seconds
    unsigned long startTime = millis();
    while (millis() - startTime < 5000) {
      if (client->available()) {
        Serial.println("From Server");
        break;
      }
    }
    delay(1000);
    for(int i = 0; i<12; i++){
      client->readStringUntil('\n');
    }
    quote = "";
    person = "";
    bool gettingPerson = false;
    char nextChar;
    startTime = millis();
    while (millis() - startTime < 1000) {
      if (client->available()) {
        nextChar = char(client->read());
        if(nextChar == '\n'){
          gettingPerson = true;
        } else{
          if(gettingPerson){
            person.concat(nextChar);
          } else{
            quote.concat(nextChar);
          }
        }
        startTime = millis();
      }
    }
    quote.replace("\n","...");
    person.replace("\n","...");
    if (person == NULL) person = "Unknown";
    client->stop();
    Serial.print("Quote:");
    Serial.println(quote);
    Serial.print("Person:");
    Serial.println(person);
    return (quote.length() > 0 && person.length() > 0);
  } else {
    Serial.println("Didn't connect to api server.");
    return false;
  }
}

bool getJoke(String &jokeSetup, String &punchline, WiFiClientSecure *client){
  if (client->connect("dad-jokes.p.rapidapi.com", 443)) {
    Serial.println("connected to server...");
    
    String http = String("GET /random/joke HTTP/1.1\r\nX-Rapidapi-Host: dad-jokes.p.rapidapi.com\r\nX-Rapidapi-Key: ")+rapidApiKey+String("\r\nHost: dad-jokes.p.rapidapi.com\r\n\r\n");
    client->print(http);
    Serial.println("requesting...");
    //let's wait for something to come back... only a few seconds
    unsigned long startTime = millis();
    while (millis() - startTime < 5000) {
      if (client->available()) {
        Serial.println("From Server");
        break;
      }
    }
    delay(1000);
    client->readStringUntil('{');
    String jsonData = "{";
    
    startTime = millis();
    while (millis() - startTime < 1000) {
      if (client->available()) {
        jsonData.concat(char(client->read()));
        startTime = millis();
      }
    }
    client->stop();
    
    Serial.println(jsonData);
    //https://arduinojson.org/v6/assistant/
    DynamicJsonDocument doc(1024);
    DeserializationError error = deserializeJson(doc, jsonData);
    if (error) {
      Serial.print("deserializeJson() failed: ");
      Serial.println(error.c_str());
      return false;
    }
    JsonObject body_0 = doc["body"][0];
    String result = body_0["setup"];
    jokeSetup = result;
    String result2 = body_0["punchline"];
    punchline = "..." + result2;

    jokeSetup.replace("\n","...");
    punchline.replace("\n","...");
    jokeSetup = jokeSetup + punchline;
    
    Serial.print("Setup:");
    Serial.println(jokeSetup);
    Serial.print("Punchline:");
    Serial.println(punchline);
    return (jokeSetup.length() > 0 && punchline.length() > 3);
  } else {
    Serial.println("Didn't connect to api server.");
    return false;
  }
}

bool getVerse(String &verse, String &reference, WiFiClientSecure *client){
  if (client->connect("beta.ourmanna.com", 443)) {
    Serial.println("connected to server...");
    
    String http = String("GET /api/v1/get?format=json&order=random HTTP/1.1\r\nAccept: application/json\r\nHost: beta.ourmanna.com\r\n\r\n");
    client->print(http);
    Serial.println("requesting...");
    //let's wait for something to come back... only a few seconds
    unsigned long startTime = millis();
    while (millis() - startTime < 5000) {
      if (client->available()) {
        Serial.println("From Server");
        break;
      }
    }
    delay(1000);
    client->readStringUntil('{');
    client->readStringUntil('{');
    client->readStringUntil('{');
    client->readStringUntil('{');
    String jsonData = "{";
    
    startTime = millis();
    while (millis() - startTime < 1000) {
      if (client->available()) {
        jsonData.concat(char(client->read()));
        startTime = millis();
      }
    }
    client->stop();
    
    Serial.println(jsonData);
    //https://arduinojson.org/v6/assistant/
    StaticJsonDocument<512> doc;
    DeserializationError error = deserializeJson(doc, jsonData);
    if (error) {
      Serial.print("deserializeJson() failed: ");
      Serial.println(error.c_str());
      return false;
    }
    JsonObject verse_ = doc["verse"];
    JsonObject verse_details = verse_["details"];
    String result = verse_details["text"];
    verse = result;
    String result2 = verse_details["reference"];
    reference = "" + result2;

    verse.replace("\n","...");
    reference.replace("\n","...");
    
    Serial.print("Verse:");
    Serial.println(verse);
    Serial.print("Reference:");
    Serial.println(reference);
    return (verse != NULL && verse.length() > 0 && reference.length() > 0);
  } else {
    Serial.println("Didn't connect to api server.");
    return false;
  }
}

bool getWordOfTheDay(String &theWord, String &theDefinition, WiFiClientSecure *client){
  if (client->connect("word-of-the-day2.p.rapidapi.com", 443)) {
    Serial.println("connected to server...");
    
    String http = String("GET /word/dc HTTP/1.1\r\nX-Rapidapi-Host: word-of-the-day2.p.rapidapi.com\r\nX-Rapidapi-Key: ")+rapidApiKey+String("\r\nHost: word-of-the-day2.p.rapidapi.com\r\n\r\n");
    client->print(http);
    Serial.println("requesting...");
    //let's wait for something to come back... only a few seconds
    unsigned long startTime = millis();
    while (millis() - startTime < 5000) {
      if (client->available()) {
        Serial.println("From Server");
        break;
      }
    }
    delay(1000);
    client->readStringUntil('[');
    //client->readStringUntil('{');
    String jsonData = "[";
    
    startTime = millis();
    while (millis() - startTime < 1000) {
      if (client->available()) {
        jsonData.concat(char(client->read()));
        startTime = millis();
      }
    }
    client->stop();
    
    Serial.println(jsonData);
    //https://arduinojson.org/v6/assistant/
    DynamicJsonDocument doc(1024);
    DeserializationError error = deserializeJson(doc, jsonData);
    if (error) {
      Serial.print("deserializeJson() failed: ");
      Serial.println(error.c_str());
      return false;
    }
    JsonObject root_0 = doc[0];
    String result = root_0["word"];
    theWord = result + ":";
    String result2 = root_0["mean"];
    theDefinition = result2;
    
    theWord.replace("\n","...");
    theDefinition.replace("\n","...");
    
    Serial.print("Word:");
    Serial.println(theWord);
    Serial.print("Definition:");
    Serial.println(theDefinition);
    return (theWord.length() > 1 && theDefinition.length() > 0);
  } else {
    Serial.println("Didn't connect to api server.");
    return false;
  }
}

bool getRandomFact(String &fact, String &none, WiFiClientSecure *client){
  if (client->connect("random-facts2.p.rapidapi.com", 443)) {
    Serial.println("connected to server...");

    String http = String("GET /getfact HTTP/1.1\r\nX-Rapidapi-Host: random-facts2.p.rapidapi.com\r\nX-Rapidapi-Key: ")+rapidApiKey+String("\r\nHost: random-facts2.p.rapidapi.com\r\n\r\n");
    client->print(http);
    Serial.println("requesting...");
    //let's wait for something to come back... only a few seconds
    unsigned long startTime = millis();
    while (millis() - startTime < 5000) {
      if (client->available()) {
        Serial.println("From Server");
        break;
      }
    }
    delay(1000);
    client->readStringUntil('{');
    String jsonData = "{";
    
    startTime = millis();
    while (millis() - startTime < 1000) {
      if (client->available()) {
        jsonData.concat(char(client->read()));
        startTime = millis();
      }
    }
    client->stop();
    
    Serial.println(jsonData);
    //https://arduinojson.org/v6/assistant/
    DynamicJsonDocument doc(1024);
    DeserializationError error = deserializeJson(doc, jsonData);
    if (error) {
      Serial.print("deserializeJson() failed: ");
      Serial.println(error.c_str());
      return false;
    }
    String result = doc["Fact"];
    fact = result;
    fact.replace("\n","...");

    Serial.print("Random Fact: ");
    Serial.println(fact);
    return true;
  } else {
    Serial.println("Didn't connect to api server.");
    return false;
  }
}

bool getDate(String &dayOfWeek, String &date, WiFiClientSecure *client){
  getNTPtime();
  rtcGetTime();
  Serial.print("rtcTimeStamp:");
  Serial.println(rtcTimeStamp); //23:05:52_6/18/22
  /*String timeStamp = rtcTimeStamp;
  int underscore = timeStamp.indexOf('_');
  int firstSlash = timeStamp.indexOf('/');
  int secondSlash = timeStamp.indexOf('/',firstSlash + 1);
  int stringLength = timeStamp.length();
  int month = timeStamp.substring(underscore + 1, firstSlash).toInt();
  int day = timeStamp.substring(firstSlash + 1, secondSlash).toInt();
  int year = 2000 + timeStamp.substring(secondSlash + 1, stringLength).toInt();*/
  Serial.println(&timeinfo, "Server Time: %A, %m %d %y %H:%M:%S");
  char timeStringBuff[50]; //50 chars should be enough
  strftime(timeStringBuff, sizeof(timeStringBuff), "%A", &timeinfo);
  dayOfWeek = timeStringBuff;
  strftime(timeStringBuff, sizeof(timeStringBuff), "%B %d, %Y", &timeinfo);
  date = timeStringBuff;
  strftime(timeStringBuff, sizeof(timeStringBuff), "%Y", &timeinfo);
  int year = atoi(timeStringBuff);
  Serial.print("Day of Week:");
  Serial.println(dayOfWeek);
  Serial.print("Date:");
  Serial.println(date);
  Serial.print("Year:");
  Serial.println(String(year));
  return (dayOfWeek.length() > 0 && date.length() > 0 && year > 2000);
}

bool getWeatherLocationKey(String &zipcode, String &locationKey, String &city, WiFiClientSecure *client){
  if (client->connect("dataservice.accuweather.com", 443)) {
    Serial.println("connected to server...");
    String http = String("GET /locations/v1/postalcodes/search?apikey=")+accuweatherKey+String("&q=") + zipcode + String(" HTTP/1.1\r\nAccept: application/json\r\nAccept-Language: en-US\r\nHost: dataservice.accuweather.com\r\n\r\n");
    client->print(http);
    Serial.println("requesting...");
    //let's wait for something to come back... only a few seconds
    unsigned long startTime = millis();
    while (millis() - startTime < 5000) {
      if (client->available()) {
        Serial.println("From Server");
        break;
      }
    }
    delay(1000);
    client->readStringUntil('[');
    String jsonData = "[";
    
    startTime = millis();
    while (millis() - startTime < 1000) {
      if (client->available()) {
        jsonData.concat(char(client->read()));
        startTime = millis();
      }
    }
    client->stop();
    
    Serial.println(jsonData);
    //https://arduinojson.org/v6/assistant/
    DynamicJsonDocument doc(16384);
    DeserializationError error = deserializeJson(doc, jsonData);
    if (error) {
      Serial.print("deserializeJson() failed: ");
      Serial.println(error.c_str());
      return false;
    }
    for(int i = 0; i < sizeof(doc)/sizeof(doc[0]); i++){
      JsonObject root_0 = doc[i];
      JsonObject root_0_Country = root_0["Country"];
      String country = root_0_Country["ID"];
      Serial.print("Country found:");
      Serial.println(country);
      if (country.equals("US")){
        String result = root_0["Key"];
        locationKey = result;
        String result2 = root_0["EnglishName"];
        city = result2;
        break;
      }
    }
    if (locationKey != NULL){
      Serial.print("Location Key: ");
      Serial.println(locationKey);
      Serial.print("City: ");
      Serial.println(city);
      return true;
    } else {
      Serial.println("Location Key not found.");
      return false;
    }
  } else {
    Serial.println("Didn't connect to api server.");
    return false;
  }
}

bool getDailyWeatherForecast(String &locationKey, struct DailyWeatherData &dailyWeatherData, WiFiClientSecure *client){
  if (client->connect("dataservice.accuweather.com", 443)) {
    Serial.println("connected to server...");
    String http = String("GET /forecasts/v1/daily/1day/") + locationKey + String("?apikey=")+accuweatherKey+String("&details=true HTTP/1.1\r\nAccept: application/json\r\nAccept-Language: en-US\r\nHost: dataservice.accuweather.com\r\n\r\n");
    client->print(http);
    Serial.println("requesting...");
    //let's wait for something to come back... only a few seconds
    unsigned long startTime = millis();
    while (millis() - startTime < 5000) {
      if (client->available()) {
        Serial.println("From Server");
        break;
      }
    }
    delay(1000);
    client->readStringUntil('{');
    String jsonData = "{";
    
    startTime = millis();
    while (millis() - startTime < 1000) {
      if (client->available()) {
        jsonData.concat(char(client->read()));
        startTime = millis();
      }
    }
    client->stop();
    
    Serial.println(jsonData);
    //https://arduinojson.org/v6/assistant/
    DynamicJsonDocument doc(6144);
    DeserializationError error = deserializeJson(doc, jsonData);
    if (error) {
      Serial.print("deserializeJson() failed: ");
      Serial.println(error.c_str());
      return false;
    }
    JsonObject DailyForecasts_0 = doc["DailyForecasts"][0];
    JsonObject DailyForecasts_0_Day = DailyForecasts_0["Day"];
    JsonObject DailyForecasts_0_Night = DailyForecasts_0["Night"];
    String desc = DailyForecasts_0_Day["LongPhrase"];
    dailyWeatherData.dayDescription = desc;
    String desc2 = DailyForecasts_0_Night["LongPhrase"];
    dailyWeatherData.nightDescription = desc2;
    JsonArray DailyForecasts_0_AirAndPollen = DailyForecasts_0["AirAndPollen"];
    for(int i = 0; i < DailyForecasts_0_AirAndPollen.size(); i++){
      JsonObject DailyForecasts_0_AirAndPollen_0 = DailyForecasts_0_AirAndPollen[i];
      if(strcmp(DailyForecasts_0_AirAndPollen_0["Name"],"AirQuality")==0) dailyWeatherData.airQuality = DailyForecasts_0_AirAndPollen_0["CategoryValue"];
      if(strcmp(DailyForecasts_0_AirAndPollen_0["Name"],"Grass")==0) dailyWeatherData.grass = DailyForecasts_0_AirAndPollen_0["CategoryValue"];
      if(strcmp(DailyForecasts_0_AirAndPollen_0["Name"],"Mold")==0) dailyWeatherData.mold = DailyForecasts_0_AirAndPollen_0["CategoryValue"];
      if(strcmp(DailyForecasts_0_AirAndPollen_0["Name"],"Ragweed")==0) dailyWeatherData.ragweed = DailyForecasts_0_AirAndPollen_0["CategoryValue"];
      if(strcmp(DailyForecasts_0_AirAndPollen_0["Name"],"Tree")==0) dailyWeatherData.tree = DailyForecasts_0_AirAndPollen_0["CategoryValue"];
      if(strcmp(DailyForecasts_0_AirAndPollen_0["Name"],"UVIndex")==0) dailyWeatherData.uvIndex = DailyForecasts_0_AirAndPollen_0["CategoryValue"];
      //String pollenName = DailyForecasts_0_AirAndPollen_0["Name"];
      //String categoryName = DailyForecasts_0_AirAndPollen_0["Category"];
      //String categoryValue = DailyForecasts_0_AirAndPollen_0["CategoryValue"];
      //allergies.concat(pollenName + "," + categoryName + "," + categoryValue + ";");
    }
    //if (allergies != NULL){
      //Serial.print("Allergies: ");
      //Serial.println(allergies);
    return true;
    //} else {
    //  Serial.println("Allergy information not found.");
    //  return false;
    //}
  } else {
    Serial.println("Didn't connect to api server.");
    return false;
  }
}

bool getHourlyWeatherForecast(String &locationKey, struct HourlyWeatherData hourlyWeatherData[], WiFiClientSecure *client){
  if (client->connect("dataservice.accuweather.com", 443)) {
    Serial.println("connected to server...");
    String http = String("GET /forecasts/v1/hourly/12hour/") + locationKey + String("?apikey=")+accuweatherKey+String("&details=true HTTP/1.1\r\nAccept: application/json\r\nAccept-Language: en-US\r\nHost: dataservice.accuweather.com\r\n\r\n");
    client->print(http);
    Serial.println("requesting...");
    //let's wait for something to come back... only a few seconds
    unsigned long startTime = millis();
    while (millis() - startTime < 5000) {
      if (client->available()) {
        Serial.println("From Server");
        break;
      }
    }
    delay(1000);
    client->readStringUntil('[');
    String jsonData = "[";
    
    startTime = millis();
    while (millis() - startTime < 1000) {
      if (client->available()) {
        jsonData.concat(char(client->read()));
        startTime = millis();
      }
    }
    client->stop();
    
    Serial.println(jsonData);
    //https://arduinojson.org/v6/assistant/
    DynamicJsonDocument doc(24576);
    DeserializationError error = deserializeJson(doc, jsonData);
    if (error) {
      Serial.print("deserializeJson() failed: ");
      Serial.println(error.c_str());
      return false;
    }
    for (int i = 0; i < 12; i++){
      JsonObject item = doc.as<JsonArray>()[i];
      String dt = item["DateTime"];
      hourlyWeatherData[i].dateTime = dt;
      hourlyWeatherData[i].weatherIcon = item["WeatherIcon"];
      hourlyWeatherData[i].isDaylight = item["IsDaylight"];
      JsonObject Temperature = item["Temperature"];
      hourlyWeatherData[i].temperature = Temperature["Value"];
      hourlyWeatherData[i].uvIndex = item["UVIndex"];
      hourlyWeatherData[i].precipitationProbability = item["PrecipitationProbability"];
    }
    return true;
    //} else {
    //  Serial.println("Hourly Weather information not found.");
    //  return false;
    //}
  } else {
    Serial.println("Didn't connect to api server.");
    return false;
  }
}

bool getSudoku(String &sudokuString, WiFiClientSecure *client){
  if (client->connect("sudoku-board.p.rapidapi.com", 443)) {
    Serial.println("connected to server...");
    String http = String("GET /new-board?diff=2&stype=string&solu=true HTTP/1.1\r\nX-Rapidapi-Host: sudoku-board.p.rapidapi.com\r\nX-Rapidapi-Key: ")+rapidApiKey+String("\r\nHost: sudoku-board.p.rapidapi.com\r\n\r\n");
    client->print(http);
    Serial.println("requesting...");
    //let's wait for something to come back... only a few seconds
    unsigned long startTime = millis();
    while (millis() - startTime < 5000) {
      if (client->available()) {
        Serial.println("From Server");
        break;
      }
    }
    delay(1000);
    client->readStringUntil('{');
    String jsonData = "{";
    
    startTime = millis();
    while (millis() - startTime < 1000) {
      if (client->available()) {
        jsonData.concat(char(client->read()));
        startTime = millis();
      }
    }
    client->stop();
    
    Serial.println(jsonData);
    //https://arduinojson.org/v6/assistant/
    DynamicJsonDocument doc(512);
    DeserializationError error = deserializeJson(doc, jsonData);
    if (error) {
      Serial.print("deserializeJson() failed: ");
      Serial.println(error.c_str());
      return false;
    }
    JsonObject response = doc["response"];
    String result = response["unsolved-sudoku"];
    sudokuString = result;
    
    Serial.print("Sudoku String:");
    Serial.println(sudokuString);
  } else {
    Serial.println("Didn't connect to api server.");
    return false;
  }
}

// 'ChuckNorris', 80x80px
const unsigned char epd_bitmap_ChuckNorris [800] PROGMEM = {
  0x00, 0x00, 0x00, 0x00, 0x00, 0x00, 0x00, 0x00, 0x00, 0x00, 0x00, 0x00, 0x00, 0x00, 0x00, 0x00, 
  0x00, 0x00, 0x00, 0x00, 0x00, 0x00, 0x00, 0x00, 0x00, 0x00, 0x00, 0x00, 0x00, 0x00, 0x00, 0x00, 
  0x00, 0x00, 0x00, 0x00, 0x00, 0x00, 0x00, 0x00, 0x00, 0x00, 0x00, 0x00, 0xf0, 0x03, 0xc0, 0x00, 
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  0x00, 0x00, 0x00, 0x00, 0x00, 0x00, 0x00, 0x00, 0x00, 0x00, 0x00, 0x00, 0x00, 0x00, 0x00, 0x00
};

// 'quote', 80x80px
const unsigned char epd_bitmap_quote [800] PROGMEM = {
  0x00, 0x00, 0x00, 0x00, 0x00, 0x00, 0x00, 0x00, 0x00, 0x00, 0x00, 0x00, 0x00, 0x00, 0x00, 0x00, 
  0x00, 0x00, 0x00, 0x00, 0x00, 0x00, 0x00, 0x00, 0x3f, 0xfc, 0x00, 0x00, 0x00, 0x00, 0x00, 0x00, 
  0x00, 0x03, 0xff, 0xff, 0xc0, 0x00, 0x00, 0x00, 0x00, 0x00, 0x00, 0x1f, 0xff, 0xff, 0xf8, 0x00, 
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  0x00, 0x00, 0x00, 0x00, 0x00, 0x00, 0x00, 0x00, 0x00, 0x00, 0x00, 0x00, 0x00, 0x00, 0x00, 0x00
};

// 'joke', 80x80px
const unsigned char epd_bitmap_joke [800] PROGMEM = {
  0x00, 0x00, 0x00, 0x00, 0x00, 0x00, 0x00, 0x00, 0x00, 0x00, 0x00, 0x00, 0x00, 0x00, 0x3f, 0xfc, 
  0x00, 0x00, 0x00, 0x00, 0x00, 0x00, 0x00, 0x03, 0xff, 0xff, 0xc0, 0x00, 0x00, 0x00, 0x00, 0x00, 
  0x00, 0x3f, 0xff, 0xff, 0xfc, 0x00, 0x00, 0x00, 0x00, 0x00, 0x00, 0xff, 0xff, 0xff, 0xff, 0x00, 
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  0x3f, 0xfc, 0x00, 0x00, 0x00, 0x00, 0x00, 0x00, 0x00, 0x00, 0x00, 0x00, 0x00, 0x00, 0x00, 0x00
};

// 'word', 80x80px
const unsigned char epd_bitmap_word [800] PROGMEM = {
  0x00, 0x00, 0x00, 0x00, 0x00, 0x00, 0x00, 0x00, 0x00, 0x00, 0x00, 0x00, 0x00, 0x00, 0x00, 0x00, 
  0x00, 0x00, 0x00, 0x00, 0x00, 0x00, 0x00, 0x00, 0x00, 0x00, 0x00, 0x00, 0x00, 0x00, 0x00, 0x00, 
  0x00, 0x00, 0x00, 0x00, 0x00, 0x00, 0x00, 0x00, 0x00, 0x00, 0x00, 0x00, 0x00, 0x00, 0x00, 0x00, 
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  0x00, 0x00, 0x00, 0x00, 0x00, 0x00, 0x00, 0x00, 0x00, 0x00, 0x00, 0x00, 0x00, 0x00, 0x00, 0x00
};

// 'fact', 80x80px
const unsigned char epd_bitmap_fact [800] PROGMEM = {
  0x00, 0x00, 0x00, 0x00, 0x00, 0x00, 0x00, 0x00, 0x00, 0x00, 0x00, 0x00, 0x00, 0x00, 0x00, 0x00, 
  0x00, 0x00, 0x00, 0x00, 0x00, 0x00, 0x00, 0x00, 0x3f, 0xfc, 0x00, 0x00, 0x00, 0x00, 0x00, 0x00, 
  0x00, 0x03, 0xff, 0xff, 0xc0, 0x00, 0x00, 0x00, 0x00, 0x00, 0x00, 0x1f, 0xff, 0xff, 0xf8, 0x00, 
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  0x00, 0x00, 0x00, 0x00, 0x00, 0x00, 0x00, 0x00, 0x00, 0x00, 0x00, 0x00, 0x00, 0x00, 0x00, 0x00
};
// 'bible', 80x80px
const unsigned char epd_bitmap_bible [800] PROGMEM = {
  0x00, 0x00, 0x00, 0x00, 0x00, 0x00, 0x00, 0x00, 0x00, 0x00, 0x00, 0x00, 0x00, 0x00, 0x00, 0x00, 
  0x00, 0x00, 0x00, 0x00, 0x00, 0x00, 0x00, 0x00, 0x00, 0x00, 0x00, 0x00, 0x00, 0x00, 0x00, 0x00, 
  0x00, 0x00, 0x00, 0x00, 0x00, 0x00, 0x00, 0x00, 0x00, 0x00, 0x00, 0x00, 0x00, 0x00, 0x00, 0x00, 
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  0x00, 0x00, 0x00, 0x00, 0x00, 0x00, 0x00, 0x00, 0x00, 0x00, 0x00, 0x00, 0x00, 0x00, 0x00, 0x00
};
// 'Accuweather_black', 100x100px
const unsigned char epd_bitmap_Accuweather_black [1364] PROGMEM = {
  0x00, 0x00, 0x00, 0x00, 0x00, 0x00, 0x00, 0x00, 0x00, 0x00, 0x00, 0x00, 0x00, 0x00, 0x00, 0x00, 
  0x00, 0x00, 0x00, 0x00, 0x00, 0x00, 0x00, 0x00, 0x00, 0x00, 0x00, 0x00, 0x00, 0x00, 0x00, 0x00, 
  0x00, 0x00, 0x00, 0x00, 0x00, 0x00, 0x00, 0x00, 0x00, 0x00, 0x00, 0x00, 0x00, 0x00, 0x00, 0x00, 
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  0x00, 0x00, 0x00, 0x00
};
// 'Accuweather_red', 100x100px
const unsigned char epd_bitmap_Accuweather_red [1348] PROGMEM = {
  0x00, 0x00, 0x00, 0x00, 0x00, 0x00, 0x00, 0x00, 0x00, 0x00, 0x00, 0x00, 0x00, 0x00, 0x00, 0x00, 
  0x00, 0x00, 0x00, 0x00, 0x00, 0x00, 0x00, 0x00, 0x00, 0x00, 0x00, 0x00, 0x00, 0x00, 0x00, 0x00, 
  0x00, 0x00, 0x00, 0x00, 0x00, 0x00, 0x00, 0x00, 0x00, 0x00, 0x00, 0x00, 0x00, 0x00, 0x00, 0x00, 
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  0x00, 0x00, 0x00, 0x00
};
// 'Cloudy', 60x60px
const unsigned char epd_bitmap_Cloudy [480] PROGMEM = {
  0x00, 0x00, 0x00, 0x00, 0x00, 0x00, 0x00, 0x00, 0x00, 0x00, 0x00, 0x00, 0x00, 0x00, 0x00, 0x00, 
  0x00, 0x00, 0x00, 0x00, 0x00, 0x00, 0x00, 0x00, 0x00, 0x00, 0x00, 0x00, 0x00, 0x00, 0x00, 0x00, 
  0x00, 0x00, 0x00, 0x00, 0x00, 0x00, 0x00, 0x00, 0x00, 0x00, 0x00, 0x00, 0x00, 0x00, 0x00, 0x00, 
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  0x00, 0x00, 0x00, 0x00, 0x00, 0x00, 0x00, 0x00, 0x00, 0x00, 0x00, 0x00, 0x00, 0x00, 0x00, 0x00
};
// 'Windy', 60x60px
const unsigned char epd_bitmap_Windy [480] PROGMEM = {
  0x00, 0x00, 0x00, 0x00, 0x00, 0x00, 0x00, 0x00, 0x00, 0x00, 0x00, 0x00, 0x00, 0x00, 0x00, 0x00, 
  0x00, 0x00, 0x00, 0x00, 0x00, 0x00, 0x00, 0x00, 0x00, 0x00, 0x00, 0x00, 0x00, 0x00, 0x00, 0x00, 
  0x00, 0x00, 0x00, 0x00, 0x00, 0x00, 0x00, 0x00, 0x00, 0x00, 0x00, 0x00, 0x00, 0x00, 0x00, 0x00, 
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  0x00, 0x00, 0x00, 0x00, 0x00, 0x00, 0x00, 0x00, 0x00, 0x00, 0x00, 0x00, 0x00, 0x00, 0x00, 0x00
};
// 'CloudyMoon', 60x60px
const unsigned char epd_bitmap_CloudyMoon [480] PROGMEM = {
  0x00, 0x00, 0x00, 0x00, 0x00, 0x00, 0x00, 0x00, 0x00, 0x00, 0x00, 0x00, 0x00, 0x00, 0x00, 0x00, 
  0x00, 0x00, 0x00, 0x00, 0x00, 0x00, 0x00, 0x00, 0x00, 0x00, 0x00, 0x00, 0x00, 0x00, 0x00, 0x00, 
  0x00, 0x00, 0x00, 0x00, 0x00, 0x00, 0x00, 0x00, 0x00, 0x00, 0x00, 0x00, 0x00, 0x00, 0x00, 0x00, 
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  0x00, 0x00, 0x00, 0x00, 0x00, 0x00, 0x00, 0x00, 0x00, 0x00, 0x00, 0x00, 0x00, 0x00, 0x00, 0x00
};
// 'Foggy', 60x60px
const unsigned char epd_bitmap_Foggy [480] PROGMEM = {
  0x00, 0x00, 0x00, 0x00, 0x00, 0x00, 0x00, 0x00, 0x00, 0x00, 0x00, 0x00, 0x00, 0x00, 0x00, 0x00, 
  0x00, 0x00, 0x00, 0x00, 0x00, 0x00, 0x00, 0x00, 0x00, 0x00, 0x00, 0x00, 0x00, 0x00, 0x00, 0x00, 
  0x00, 0x00, 0x00, 0x00, 0x00, 0x00, 0x00, 0x00, 0x00, 0x00, 0x00, 0x00, 0x00, 0x00, 0x00, 0x00, 
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  0x00, 0x00, 0x00, 0x00, 0x00, 0x00, 0x00, 0x00, 0x00, 0x00, 0x00, 0x00, 0x00, 0x00, 0x00, 0x00
};
// 'Mixed', 60x60px
const unsigned char epd_bitmap_Mixed [480] PROGMEM = {
  0x00, 0x00, 0x00, 0x00, 0x00, 0x00, 0x00, 0x00, 0x00, 0x00, 0x00, 0x00, 0x00, 0x00, 0x00, 0x00, 
  0x00, 0x00, 0x00, 0x00, 0x00, 0x00, 0x00, 0x00, 0x00, 0x00, 0x00, 0x00, 0x00, 0x00, 0x00, 0x00, 
  0x00, 0x00, 0x00, 0x00, 0x00, 0x00, 0x00, 0x00, 0x00, 0x00, 0x00, 0x00, 0x00, 0x00, 0x00, 0x00, 
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  0x00, 0x00, 0x00, 0x00, 0x00, 0x00, 0x00, 0x00, 0x00, 0x00, 0x00, 0x00, 0x00, 0x00, 0x00, 0x00
};
// 'Moon', 60x60px
const unsigned char epd_bitmap_Moon [480] PROGMEM = {
  0x00, 0x00, 0x00, 0x00, 0x00, 0x00, 0x00, 0x00, 0x00, 0x00, 0x00, 0x00, 0x00, 0x00, 0x00, 0x00, 
  0x00, 0x00, 0x00, 0x00, 0x00, 0x00, 0x00, 0x00, 0x00, 0x00, 0x00, 0x00, 0x00, 0x00, 0x00, 0x00, 
  0x00, 0x00, 0x00, 0x00, 0x00, 0x00, 0x00, 0x00, 0x00, 0x00, 0x00, 0x00, 0x00, 0x00, 0x00, 0x00, 
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  0x00, 0x00, 0x00, 0x00, 0x00, 0x00, 0x00, 0x00, 0x00, 0x00, 0x00, 0x00, 0x00, 0x00, 0x00, 0x00
};
// 'PartlySunny', 60x60px
const unsigned char epd_bitmap_PartlySunny [480] PROGMEM = {
  0x00, 0x00, 0x00, 0x00, 0x00, 0x00, 0x00, 0x00, 0x00, 0x00, 0x00, 0x00, 0x00, 0x00, 0x00, 0x00, 
  0x00, 0x00, 0x00, 0x00, 0x00, 0x00, 0x00, 0x00, 0x00, 0x00, 0x00, 0x00, 0x00, 0x00, 0x00, 0x00, 
  0x00, 0x00, 0x00, 0x00, 0x00, 0x00, 0x00, 0x00, 0x00, 0x00, 0x00, 0x00, 0x00, 0x40, 0x00, 0x00, 
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  0x00, 0x00, 0x00, 0x00, 0x00, 0x00, 0x00, 0x00, 0x00, 0x00, 0x00, 0x00, 0x00, 0x00, 0x00, 0x00
};
// 'Rainy', 60x60px
const unsigned char epd_bitmap_Rainy [480] PROGMEM = {
  0x00, 0x00, 0x00, 0x00, 0x00, 0x00, 0x00, 0x00, 0x00, 0x00, 0x00, 0x00, 0x00, 0x00, 0x00, 0x00, 
  0x00, 0x00, 0x00, 0x00, 0x00, 0x00, 0x00, 0x00, 0x00, 0x00, 0x00, 0x00, 0x00, 0x00, 0x00, 0x00, 
  0x00, 0x00, 0x00, 0x00, 0x00, 0x00, 0x00, 0x00, 0x00, 0x00, 0x00, 0x00, 0x00, 0x00, 0x00, 0x00, 
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  0x00, 0x00, 0x00, 0x00, 0x00, 0x00, 0x00, 0x00, 0x00, 0x00, 0x00, 0x00, 0x00, 0x00, 0x00, 0x00
};
// 'PartialCloud', 60x60px
const unsigned char epd_bitmap_PartialCloud [480] PROGMEM = {
  0x00, 0x00, 0x00, 0x00, 0x00, 0x00, 0x00, 0x00, 0x00, 0x00, 0x00, 0x00, 0x00, 0x00, 0x00, 0x00, 
  0x00, 0x00, 0x00, 0x00, 0x00, 0x00, 0x00, 0x00, 0x00, 0x00, 0x00, 0x00, 0x00, 0x00, 0x00, 0x00, 
  0x00, 0x00, 0x00, 0x00, 0x00, 0x00, 0x00, 0x00, 0x00, 0x00, 0x00, 0x00, 0x00, 0x00, 0x00, 0x00, 
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  0x00, 0x00, 0x00, 0x00, 0x00, 0x00, 0x00, 0x00, 0x00, 0x00, 0x00, 0x00, 0x00, 0x00, 0x00, 0x00
};
// 'Snowy', 60x60px
const unsigned char epd_bitmap_Snowy [480] PROGMEM = {
  0x00, 0x00, 0x00, 0x00, 0x00, 0x00, 0x00, 0x00, 0x00, 0x00, 0x00, 0x00, 0x00, 0x00, 0x00, 0x00, 
  0x00, 0x00, 0x00, 0x00, 0x00, 0x00, 0x00, 0x00, 0x00, 0x00, 0x00, 0x00, 0x00, 0x00, 0x00, 0x00, 
  0x00, 0x00, 0x00, 0x00, 0x00, 0x00, 0x00, 0x00, 0x00, 0x00, 0x00, 0x00, 0x00, 0x00, 0x00, 0x00, 
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  0x00, 0x00, 0x00, 0x00, 0x00, 0x00, 0x00, 0x00, 0x00, 0x00, 0x00, 0x00, 0x00, 0x00, 0x00, 0x00
};
// 'Sunny', 60x60px
const unsigned char epd_bitmap_Sunny [480] PROGMEM = {
  0x00, 0x00, 0x00, 0x00, 0x00, 0x00, 0x00, 0x00, 0x00, 0x00, 0x00, 0x0e, 0x00, 0x00, 0x00, 0x00, 
  0x00, 0x00, 0x00, 0x0e, 0x00, 0x00, 0x00, 0x00, 0x00, 0x00, 0x00, 0x1f, 0x00, 0x00, 0x00, 0x00, 
  0x00, 0x00, 0x00, 0x1f, 0x00, 0x00, 0x00, 0x00, 0x00, 0x00, 0x00, 0x1f, 0x00, 0x00, 0x00, 0x00, 
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  0x00, 0x00, 0x00, 0x0e, 0x00, 0x00, 0x00, 0x00, 0x00, 0x00, 0x00, 0x00, 0x00, 0x00, 0x00, 0x00
};
// 'Stormy', 60x60px
const unsigned char epd_bitmap_Stormy [480] PROGMEM = {
  0x00, 0x00, 0x00, 0x00, 0x00, 0x00, 0x00, 0x00, 0x00, 0x00, 0x00, 0x00, 0x00, 0x00, 0x00, 0x00, 
  0x00, 0x00, 0x00, 0x00, 0x00, 0x00, 0x00, 0x00, 0x00, 0x00, 0x00, 0x00, 0x00, 0x00, 0x00, 0x00, 
  0x00, 0x00, 0x00, 0x00, 0x00, 0x00, 0x00, 0x00, 0x00, 0x00, 0x00, 0x00, 0x00, 0x00, 0x00, 0x00, 
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  0x00, 0x00, 0x00, 0x00, 0x00, 0x00, 0x00, 0x00, 0x00, 0x00, 0x00, 0x00, 0x00, 0x00, 0x00, 0x00
};
// 'mold', 40x40px
const unsigned char epd_bitmap_mold [200] PROGMEM = {
  0x00, 0x00, 0x00, 0x00, 0x00, 0x00, 0x00, 0x00, 0x00, 0x00, 0x00, 0x00, 0x00, 0x00, 0x00, 0x00, 
  0x00, 0x00, 0x00, 0x00, 0x00, 0x00, 0x00, 0x00, 0x00, 0x00, 0x00, 0x00, 0x00, 0xf0, 0x00, 0x00, 
  0x00, 0x01, 0xf0, 0x00, 0x00, 0x07, 0x01, 0xf0, 0x00, 0x00, 0x0f, 0x80, 0xf0, 0x00, 0x0f, 0x8f, 
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  0x00, 0x00, 0x00, 0x00, 0x00, 0x00, 0x00, 0x00
};
// 'grass', 40x40px
const unsigned char epd_bitmap_grass [200] PROGMEM = {
  0x00, 0x00, 0x00, 0x00, 0x00, 0x00, 0x00, 0x00, 0x00, 0x00, 0x00, 0x00, 0x00, 0x00, 0x00, 0x00, 
  0x40, 0x00, 0x00, 0x00, 0x00, 0x60, 0x00, 0x00, 0x00, 0x00, 0x30, 0x00, 0x00, 0x00, 0x00, 0x18, 
  0x00, 0x00, 0x00, 0x00, 0x1c, 0x00, 0x00, 0x00, 0x00, 0x0e, 0x00, 0x00, 0x80, 0x00, 0x0f, 0x00, 
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  0x3e, 0x7e, 0x00, 0x00, 0x00, 0x00, 0x00, 0x00
};
// 'tree', 40x40px
const unsigned char epd_bitmap_tree [200] PROGMEM = {
  0x00, 0x00, 0x00, 0x00, 0x00, 0x00, 0x00, 0xfe, 0x00, 0x00, 0x00, 0x00, 0xff, 0x80, 0x00, 0x00, 
  0x07, 0xff, 0xc0, 0x00, 0x00, 0x0f, 0xff, 0xe0, 0x00, 0x00, 0x1f, 0xff, 0xf0, 0x00, 0x00, 0x1f, 
  0xff, 0xf0, 0x00, 0x00, 0x7f, 0xff, 0xff, 0x00, 0x00, 0x7f, 0xff, 0xff, 0x80, 0x01, 0xff, 0xff, 
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  0x3e, 0x00, 0x00, 0x00, 0x00, 0x3f, 0x00, 0x00
};
// 'ragweed', 40x40px
const unsigned char epd_bitmap_ragweed [200] PROGMEM = {
  0x00, 0x00, 0x00, 0x00, 0x00, 0x00, 0x00, 0x18, 0x00, 0x00, 0x00, 0x00, 0x2c, 0x00, 0x00, 0x00, 
  0x00, 0x3c, 0x00, 0x00, 0x00, 0x00, 0x58, 0x00, 0x00, 0x00, 0x00, 0xb0, 0x00, 0x00, 0x00, 0x00, 
  0xb0, 0x00, 0x00, 0x00, 0x00, 0x57, 0x00, 0x00, 0x00, 0x00, 0x1d, 0x00, 0x00, 0x00, 0x00, 0xf7, 
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  0x00, 0x00, 0x00, 0x00, 0x00, 0x00, 0x00, 0x00
};
// 'battery', 20x10px
const unsigned char epd_bitmap_battery [30] PROGMEM = {
  0x00, 0x00, 0x00, 0x7f, 0xff, 0xc0, 0x40, 0x00, 0x40, 0x5c, 0x00, 0x60, 0x5c, 0x00, 0x60, 0x5c, 
  0x00, 0x60, 0x5c, 0x00, 0x60, 0x5c, 0x00, 0x60, 0x40, 0x00, 0x40, 0x7f, 0xff, 0xc0
};

class Sudoku {
  public:
    bool initialized = false;
    int gridStartingLine = 200;
    int gridWidth = 400;
    int gridLeft = (480-gridWidth)/2;
    float gridPitch = gridWidth / 9.0;
    int vOffset = gridPitch - 8;
    int hOffset = 9;
    uint16_t backgroundColor = GxEPD_WHITE;
    uint16_t gridColor = GxEPD_BLACK;
    uint16_t textColor = GxEPD_BLACK;
    String sudokuString = "...4.6..9456......78912.........4.9.3.2.9.6.4..8...2......4.3.883......22...6..4.";
    bool initialize(WiFiClientSecure *client){
      if(getSudoku(sudokuString, client)){
        initialized = true;
        return true;
      } else{
        return false;
      }
    }
    void updateDisplay(){
      display.fillScreen(backgroundColor);
      display.drawRect(gridLeft, gridStartingLine, gridWidth, gridWidth, gridColor);
      display.drawRect(gridLeft+1, gridStartingLine+1, gridWidth-2, gridWidth-2, gridColor);
      display.drawRect(gridLeft + 1*gridPitch, gridStartingLine, gridWidth - 2*gridPitch, gridWidth, gridColor);
      display.drawRect(gridLeft + 2*gridPitch, gridStartingLine, gridWidth - 4*gridPitch, gridWidth, gridColor);
      display.drawRect(gridLeft + 3*gridPitch, gridStartingLine, gridWidth - 6*gridPitch, gridWidth, gridColor);
      display.drawRect(gridLeft + 3*gridPitch + 1, gridStartingLine, gridWidth - 6*gridPitch, gridWidth, gridColor);
      display.drawRect(gridLeft + 3*gridPitch - 1, gridStartingLine, gridWidth - 6*gridPitch, gridWidth, gridColor);
      display.drawRect(gridLeft + 4*gridPitch, gridStartingLine, gridWidth - 8*gridPitch, gridWidth, gridColor);
      display.drawRect(gridLeft, gridStartingLine + 1*gridPitch, gridWidth, gridWidth - 2*gridPitch, gridColor);
      display.drawRect(gridLeft, gridStartingLine + 2*gridPitch, gridWidth, gridWidth - 4*gridPitch, gridColor);
      display.drawRect(gridLeft, gridStartingLine + 3*gridPitch, gridWidth, gridWidth - 6*gridPitch, gridColor);
      display.drawRect(gridLeft, gridStartingLine + 3*gridPitch + 1, gridWidth, gridWidth - 6*gridPitch, gridColor);
      display.drawRect(gridLeft, gridStartingLine + 3*gridPitch - 1, gridWidth, gridWidth - 6*gridPitch, gridColor);
      display.drawRect(gridLeft, gridStartingLine + 4*gridPitch, gridWidth, gridWidth - 8*gridPitch, gridColor);
      setFont(24);
      display.setTextColor(textColor);
      for(int i=0; i<9; i++){
        for(int j=0; j<9; j++){
          display.setCursor(gridLeft + hOffset + j * gridPitch, gridStartingLine + vOffset + i * gridPitch);
          int index = i*9+j;
          String number = sudokuString.substring(index,index+1);
          if(!number.equals(".")){
            display.println(number);
          }
        }
      }
    }
};

class WeatherWidget {
  public:
    bool initialized = false;
    DailyWeatherData dailyWeatherData;
    HourlyWeatherData hourlyWeatherData[12];
    String zipcode = "60073";//"96795";
    String locationKey = "37935_PC";
    String city = "Name of City";
    int top = 0;
    int columnWidth = 74;
    String lines1[1];
    int lineCount1;
    int fontSize1;
    String lines2[11];
    int lineCount2;
    int fontSize2;
    int myFontSizes[7] = { 48, 36, 24, 18, 12, 9, 6 };
    bool initialize(WiFiClientSecure *client, String zipcodeToUse, int &startingLine){
      top = startingLine;
      zipcode = zipcodeToUse;
      if(getWeatherLocationKey(zipcode, locationKey, city, client)){
        if(getDailyWeatherForecast(locationKey, dailyWeatherData, client)){
          Serial.print("Daily Weather Data:");
          Serial.print(dailyWeatherData.dayDescription + ",");
          Serial.print(dailyWeatherData.nightDescription + ",");
          Serial.print(String(dailyWeatherData.airQuality) + ",");
          Serial.print(String(dailyWeatherData.grass) + ",");
          Serial.print(String(dailyWeatherData.mold) + ",");
          Serial.print(String(dailyWeatherData.ragweed) + ",");
          Serial.print(String(dailyWeatherData.tree) + ",");
          Serial.println(String(dailyWeatherData.uvIndex));
          bool textFits = getLinesAndFontThatFit(lines1, lineCount1, fontSize1, city, myFontSizes, 7, 275, 20);
          textFits = textFits && getLinesAndFontThatFit(lines2, lineCount2, fontSize2, "Today: " + dailyWeatherData.dayDescription, myFontSizes, 7, 265, 80);
          if(getHourlyWeatherForecast(locationKey, hourlyWeatherData, client)){
            Serial.println("Hourly Weather Data:");
            for(int i = 0; i < 12; i++){
              Serial.print(hourlyWeatherData[i].dateTime + ": ");
              Serial.print(String(hourlyWeatherData[i].weatherIcon) + ",");
              Serial.print(String(hourlyWeatherData[i].isDaylight) + ",");
              Serial.print(String(hourlyWeatherData[i].temperature) + ",");
              Serial.print(String(hourlyWeatherData[i].uvIndex) + ",");
              Serial.println(String(hourlyWeatherData[i].precipitationProbability));
            }
            if(textFits){
              initialized = true;
              startingLine = startingLine + 300;
              return true;
            } else{
              Serial.println("Weather description doesn't fit.");
              return false;
            }
          }
        }
      }
      return false;
    }
    void getWeatherIcon(int weatherIconNumber, const unsigned char* &icon, const unsigned char* &iconRed){
      switch(weatherIconNumber){
        case 1:
        case 2:
        case 30:
          icon = epd_bitmap_Sunny;
          break;
        case 3:
        case 4:
        case 5:
          icon = epd_bitmap_PartlySunny;
          break;
        case 6:
        case 7:
        case 8:
        case 31:
          icon = epd_bitmap_Cloudy;
          break;
        case 11:
          icon = epd_bitmap_Foggy;
          break;
        case 12:
        case 13:
        case 14:
        case 18:
        case 39:
        case 40:
          icon = epd_bitmap_PartialCloud;
          iconRed = epd_bitmap_Rainy;
          break;
        case 15:
        case 16:
        case 17:
        case 41:
        case 42:
          icon = epd_bitmap_PartialCloud;
          iconRed = epd_bitmap_Stormy;
          break;
        case 19:
        case 20:
        case 21:
        case 22:
        case 23:
        case 43:
        case 44:
          icon = epd_bitmap_PartialCloud;
          iconRed = epd_bitmap_Snowy;
          break;
        case 24:
        case 25:
        case 26:
        case 29:
          icon = epd_bitmap_PartialCloud;
          iconRed = epd_bitmap_Mixed;
          break;
        case 32:
          icon = epd_bitmap_Windy;
          break;
        case 33:
        case 34:
          icon = epd_bitmap_Moon;
          break;
        case 35:
        case 36:
        case 37:
        case 38:
          icon = epd_bitmap_CloudyMoon;
          break;
        default:
          icon = epd_bitmap_Foggy;
      }
    }
    void updateDisplay(){
      //figure out where all the temperature graph points should be
      int minTemp = 200;
      int maxTemp = -200;
      for (int i = 0; i < 12; i++){
        if(hourlyWeatherData[i].temperature < minTemp) minTemp = hourlyWeatherData[i].temperature;
        if(hourlyWeatherData[i].temperature > maxTemp) maxTemp = hourlyWeatherData[i].temperature;
      }
      if (minTemp == maxTemp) minTemp = maxTemp - 1;  //prevent range of 0
      int range = maxTemp - minTemp;
      int x[12];
      int y[12];
      for (int i = 0; i < 12; i++){
        y[i] = (maxTemp-hourlyWeatherData[i].temperature)*68 / range + top + 105 + 100;
        x[i] = (columnWidth / 2) * (i + 1);
        //Serial.println("hour " + String(i) + ": x:" + String(x[i]) + ", y:" + String(y[i]));
      }
      //draw a box around the AccuWeather logo
      display.drawLine(0, top, 0, top + 102, GxEPD_BLACK);
      display.drawLine(101, top, 101, top + 102, GxEPD_BLACK);
      display.drawLine(0, top, 101, top, GxEPD_BLACK);
      display.drawLine(0, top + 102, 101, top + 102, GxEPD_BLACK);
      //draw the accuweather logo
      display.drawBitmap(0, top, epd_bitmap_Accuweather_black, 100, 100, GxEPD_BLACK);
      display.drawBitmap(0, top, epd_bitmap_Accuweather_red, 100, 100, GxEPD_RED);
      //Write the city name
      setFont(fontSize1);
      display.setTextColor(GxEPD_RED);
      addTextToDisplay(lines1, lineCount1, fontSize1, 105, top, 275, 20, 0, 0);
      //Write the weather forecast text
      setFont(fontSize2);
      display.setTextColor(GxEPD_BLACK);
      addTextToDisplay(lines2, lineCount2, fontSize2, 110, top + 20, 265, 80, 0, -1);
      //draw a box around the allergy forecast info
      display.drawLine(379, top, 379, top + 102, GxEPD_BLACK);
      display.drawLine(479, top, 479, top + 102, GxEPD_BLACK);
      display.drawLine(379, top, 479, top, GxEPD_BLACK);
      display.drawLine(379, top + 102, 479, top + 102, GxEPD_BLACK);
      //draw icons and labels for the allergy forecast
      setFont(6);
      display.setTextColor(GxEPD_BLACK);
      if (dailyWeatherData.mold >=3){
        display.drawBitmap(385, top, epd_bitmap_mold, 40, 40, GxEPD_RED);
      } else if(dailyWeatherData.mold > 1){
        display.drawBitmap(385, top, epd_bitmap_mold, 40, 40, GxEPD_BLACK);
      }
      String moldString[1] = {String("Mold")};
      addTextToDisplay(moldString, 1, 6, 380, top + 33, 50, 11, 0, 1);
      if (dailyWeatherData.grass >=3){
        display.drawBitmap(435, top, epd_bitmap_grass, 40, 40, GxEPD_RED);
      } else if(dailyWeatherData.grass > 1){
        display.drawBitmap(435, top, epd_bitmap_grass, 40, 40, GxEPD_BLACK);
      }
      String grassString[1] = {String("Grass")};
      addTextToDisplay(grassString, 1, 6, 430, top + 33, 50, 11, 0, 1);
      if (dailyWeatherData.ragweed >=3){
        display.drawBitmap(385, top + 50, epd_bitmap_ragweed, 40, 40, GxEPD_RED);
      } else if(dailyWeatherData.ragweed > 1){
        display.drawBitmap(385, top + 50, epd_bitmap_ragweed, 40, 40, GxEPD_BLACK);
      }
      String ragweedString[1] = {String("Ragweed")};
      addTextToDisplay(ragweedString, 1, 6, 380, top + 83, 50, 11, 0, 1);
      if (dailyWeatherData.tree >=3){
        display.drawBitmap(435, top + 50, epd_bitmap_tree, 40, 40, GxEPD_RED);
      } else if(dailyWeatherData.tree > 1){
        display.drawBitmap(435, top + 50, epd_bitmap_tree, 40, 40, GxEPD_BLACK);
      }
      String treeString[1] = {String("Tree")};
      addTextToDisplay(treeString, 1, 6, 430, top + 83, 50, 11, 0, 1);
      //Hourly weather forecast
      for (int i = 0; i < 12; i++){
        //only display every other hour
        if (i%2 == 0){
          int hour = hourlyWeatherData[i].dateTime.substring(11,13).toInt();
          String hourString = "";
          if (hour==0) {
            hourString = "12am";
          } else if (hour < 13) {
            hourString = String(hour) + "am";
          } else if (hour < 24) {
            hourString = String(hour-12) + "pm";
          }
          //display hour of day
          String hourStringArray[1] = {hourString};
          setFont(12);
          display.setTextColor(GxEPD_BLACK);
          addTextToDisplay(hourStringArray, 1, 12, i/2*columnWidth, top + 105, columnWidth, 22, 0, 0);
          //display weather icon
          const unsigned char* icon = NULL;
          const unsigned char* iconRed = NULL;
          getWeatherIcon(hourlyWeatherData[i].weatherIcon, icon, iconRed);
          display.drawBitmap(i/2*columnWidth + 7, top + 32 + 100, icon, 60, 60, GxEPD_BLACK);
          if(iconRed != NULL){
            display.drawBitmap(i/2*columnWidth + 7, top + 32 + 100, iconRed, 60, 60, GxEPD_RED);
          }
          //display chance of rain
          if (hourlyWeatherData[i].precipitationProbability >= 20){
            setFont(9);
            display.setTextColor(GxEPD_RED);
            String chancePrecip[1] = {String(hourlyWeatherData[i].precipitationProbability) + "%"};
            addTextToDisplay(chancePrecip, 1, 12, i/2*columnWidth, top + 82 + 100, columnWidth, 18, 1, 0);
          }
        }
        //print dots and lines for temperature chart
        if(hourlyWeatherData[i].isDaylight == 0){
          display.fillCircle(x[i], y[i], 2, GxEPD_BLACK);
        } else {
          if (hourlyWeatherData[i].uvIndex >= 3){
            display.drawCircle(x[i], y[i], 2, GxEPD_RED);
          } else {
            display.drawCircle(x[i], y[i], 2, GxEPD_BLACK);
          }
        }
        int lowestYIncludingAdjacentTemps;
        if (i < 11){
          if (hourlyWeatherData[i].uvIndex >= 3 && hourlyWeatherData[i+1].uvIndex >= 3){
            display.drawLine(x[i], y[i], x[i+1], y[i+1], GxEPD_RED);
          } else {
            display.drawLine(x[i], y[i], x[i+1], y[i+1], GxEPD_BLACK);
          }
          if (i == 0) { // i=0
            lowestYIncludingAdjacentTemps = max(y[i],y[i+1]);
          } else { // i between 0 and 11
            lowestYIncludingAdjacentTemps = max(y[i-1],max(y[i],y[i+1]));
          }
        } else { // i=11
          lowestYIncludingAdjacentTemps = max(y[i-1],y[i]);
        }
        //create temperature labels for every other hour, place them under the point, but so the lines don't cover them
        if(i%2 == 0){
          String tempArray[1] = {String(hourlyWeatherData[i].temperature) + ""};
          setFont(12);
          display.setTextColor(GxEPD_BLACK);
          addTextToDisplay(tempArray, 1, 12, i/2*columnWidth, lowestYIncludingAdjacentTemps + 5, columnWidth, 26, 0, 0); //top + 173 + 100
        }
      }
    }
};

class Widget {
  public:
    //icon parameters
    const unsigned char* icon = NULL;
    const unsigned char* iconRed = NULL;
    int iconWidth = 80;
    int iconHeight = 80;
    int iconLeft = 10;
    int iconTop = 10;
    //first text block parameters
    String text;
    int top;
    int left = 99;
    int boundingHeight = 100;
    int boundingWidth = 375;
    int text1JustifyV = 0;
    int text1JustifyH = 0;
    uint16_t text1Color = GxEPD_BLACK;
    int fontSize;
    String lines[11];
    int lineCount;
    //second text block parameters
    String text2;
    int text2Height = 0;
    int text2JustifyV = 0;
    int text2JustifyH = 0;
    uint16_t text2Color = GxEPD_RED;
    int fontSize2;
    String lines2[11];
    int lineCount2;
    //text management
    int myFontSizes[7] = { 48, 36, 24, 18, 12, 9, 6 };
    bool textFits = false;
    bool (*textGrabber)(String&, String&, WiFiClientSecure*);
    bool receivedText = false;
    
    bool initialize(WiFiClientSecure *client, bool (*textGrabberToUse)(String&, String&, WiFiClientSecure*), int &startingLine){
      textGrabber = textGrabberToUse;
      top = startingLine;
      iconTop = iconTop + startingLine;
      receivedText = textGrabber(text, text2, client);
      if(receivedText){
        textFits = getLinesAndFontThatFit(lines, lineCount, fontSize, text, myFontSizes, 7, boundingWidth, boundingHeight - text2Height);
        if(text2Height > 0){
          textFits = textFits && getLinesAndFontThatFit(lines2, lineCount2, fontSize2, text2, myFontSizes, 7, boundingWidth, text2Height);
        }
        if(textFits){
          startingLine = startingLine + boundingHeight;
          return true;
        } else{
          return false;
        }
      }else{
        Serial.println("Failed to get text from server.");
        return false; //didn't get data
      }
    }
    void updateDisplay(){
      if (icon != NULL){
        //Serial.println("Ready to draw black icon...");
        display.drawBitmap(iconLeft, iconTop, icon, iconWidth, iconHeight, GxEPD_BLACK);
      }
      if (iconRed != NULL){
        //Serial.println("Ready to draw red icon...");
        display.drawBitmap(iconLeft, iconTop, iconRed, iconWidth, iconHeight, GxEPD_RED);
      }
      Serial.println("Ready to draw text...");
      setFont(fontSize);
      display.setTextColor(text1Color);
      addTextToDisplay(lines, lineCount, fontSize, left, top, boundingWidth, boundingHeight - text2Height, text1JustifyH, text1JustifyV);
      if(text2Height > 0){
        display.setTextColor(text2Color);
        setFont(fontSize2);
        addTextToDisplay(lines2, lineCount2, fontSize2, left, top + boundingHeight - text2Height, boundingWidth, text2Height, text2JustifyH, text2JustifyV);
      }
    }
};

void ePaperInstructions() {
  disableAlarm();
  display.init();
  SPI.end();
  SPI.begin(14, 12, 13, 15);
  display.setRotation(2);
  display.setTextWrap(false);
  Serial.println("Displaying On-Screen Instructions...");
  display.firstPage();
  do
  {
    display.fillScreen(GxEPD_WHITE);
    display.setCursor(0, 30);
    setFont(24);
    display.setTextColor(GxEPD_RED);
    display.setCursor(0, 30);
    display.print("Smart Screen Instructions");
    display.setTextColor(GxEPD_BLACK);
    setFont(9);
    display.println("");
    display.println("");
    setFont(12);
    display.println("From a laptop's Chrome browser, browse to...");
    display.println("https://krdarrah.github.io/trigBoardConfigurator/");
    display.println("... to connect to \"trigBoard\" using Bluetooth.");
    setFont(9);
    display.println("");
    display.println("Enter your WiFi router name (SSID) and password, then select save.");
    display.println("");
    display.println("The information displayed is set using the field for");
    display.println("\"trigBoard Name\", where each letter code in the name");
    display.println("represents a different widget to display.");
    display.println("d -> date");
    display.println("w12345 -> weather forecast, where \"12345\" is zipcode");
    display.println("o -> word of the day");
    display.println("q -> inspirational quote");
    display.println("f -> interesting fact");
    display.println("b -> bible verse");
    display.println("j -> joke (not always kid-friendly)");
    display.println("c -> Chuck Norris joke (not always kid-friendly)");
    display.println("Remember to save. Click \"DISCONNECT\" when finished.");
    display.println("");
    display.println("When the LED is on, wait while the display updates.");
    display.println("Press the button for 1 second to force an update.");
    display.println("Return to this screen by holding the button, until the screen goes black.");
  }
  while (display.nextPage());
}

void ePaperClear(uint16_t color) {
  display.firstPage();
  do
  {
    display.fillScreen(color);
  }
  while (display.nextPage());
}

Widget quote;
WeatherWidget weather;
Widget day;
Widget joke;
Widget chuckNorris;
Widget wordOfTheDay;
Widget bibleVerse;
Widget randomFact;
Sudoku soduku;

void ePaperUpdate(int mode) {
  display.init();
  SPI.end();
  SPI.begin(14, 12, 13, 15);
  WiFiClientSecure client;
  //ePaperClear();
  if (WiFi.status() != WL_CONNECTED) {
    Serial.println("Wifi not really connected.");
    ePaperInstructions();
    return;
  }
  client.setInsecure();
  display.setRotation(3);
  display.setTextWrap(false);
  if(mode == 0){
    //Widget chuckNorris;
    //chuckNorris.icon = epd_bitmap_ChuckNorris;
    //Widget quote;
    quote.icon = epd_bitmap_quote;
    quote.text2Height = 17;
    quote.text2JustifyH = 1;
    //Widget bibleVerse;
    bibleVerse.icon = epd_bitmap_bible;
    bibleVerse.text2Height = 17;
    bibleVerse.text2JustifyH = 1;
    //Widget joke;
    joke.icon = epd_bitmap_joke;
    //joke.text2Height = 50;
    //Widget wordOfTheDay;
    wordOfTheDay.icon = epd_bitmap_word;
    wordOfTheDay.text2Height = 70;
    wordOfTheDay.text1JustifyH = -1;
    wordOfTheDay.text1JustifyV = 1;
    //Widget randomFact;
    randomFact.icon = epd_bitmap_fact;
    //Widget day;
    day.text2Height = 40;
    day.left = 5;
    day.boundingWidth = 470;
    if(lowBattery) day.text1Color = GxEPD_RED;
    //day.icon = epd_bitmap_Accuweather_black;
    //day.iconRed = epd_bitmap_Accuweather_red;
    //day.iconWidth = 100;
    //day.iconHeight = 100;
    //day.iconLeft = 379;;
    //day.iconTop = 0;
    //WeatherWidget weather;
    int startingLine = 0;
    char* pattern = "dw60073qofbjc";
    pattern = config.trigName;
    //pattern = "b";
    for (int i=0; startingLine < 800; i++){
      if (pattern[i]=='c'){
        Serial.println("Initialize Chuck Norris...");
        if(!chuckNorris.initialize(&client, &getChuckNorrisSaying, startingLine)) //try all widgets twice
          chuckNorris.initialize(&client, &getChuckNorrisSaying, startingLine);
      } else if(pattern[i]=='q'){
        Serial.println("Initialize Quote...");
        if(!quote.initialize(&client, &getQuote, startingLine))
          quote.initialize(&client, &getQuote, startingLine);
      } else if(pattern[i]=='j'){
        Serial.println("Initialize Joke...");
        if(!joke.initialize(&client, &getJoke, startingLine))
          joke.initialize(&client, &getJoke, startingLine);
      } else if(pattern[i]=='o'){
        Serial.println("Initialize Word of the Day...");
        if(!wordOfTheDay.initialize(&client, &getWordOfTheDay, startingLine))
          wordOfTheDay.initialize(&client, &getWordOfTheDay, startingLine);
      } else if(pattern[i]=='f'){
        Serial.println("Initialize Random Fact...");
        if(!randomFact.initialize(&client, &getRandomFact, startingLine))
          randomFact.initialize(&client, &getRandomFact, startingLine);
      } else if(pattern[i]=='d'){
        Serial.println("Initialize Day and Date...");
        if(!day.initialize(&client, &getDate, startingLine))
          day.initialize(&client, &getDate, startingLine);
      } else if(pattern[i]=='b'){
        Serial.println("Initialize Bible Verse...");
        if(!bibleVerse.initialize(&client, &getVerse, startingLine))
          bibleVerse.initialize(&client, &getVerse, startingLine);
      } else if(pattern[i]=='w'){
        Serial.println("Initialize Weather...");
        String zipcode = String(substr(pattern,i+1,5));
        Serial.print("Extracted zipcode: ");
        i = i + 5;
        Serial.println(zipcode);
        if(!weather.initialize(&client, zipcode, startingLine))
          weather.initialize(&client, zipcode, startingLine);
      } else {
        break;
      }
    }
    display.firstPage();
    do
    {
      if(chuckNorris.textFits) chuckNorris.updateDisplay();
      if(quote.textFits) quote.updateDisplay();
      if(joke.textFits) joke.updateDisplay();
      if(wordOfTheDay.textFits) wordOfTheDay.updateDisplay();
      if(randomFact.textFits) randomFact.updateDisplay();
      if(day.textFits) day.updateDisplay();
      if(weather.initialized) weather.updateDisplay();
      if(bibleVerse.textFits) bibleVerse.updateDisplay();
      if(lowBattery) display.drawBitmap(460, 0, epd_bitmap_battery, 20, 10, GxEPD_RED);
    }
    while (display.nextPage());
  } else if(mode == 1){
    ePaperClear(GxEPD_WHITE);
  } else if(mode == 2){
    Serial.println("Initialize Sudoku...");
    Sudoku sudoku;
    if(!sudoku.initialize(&client)) //try twice to update
      sudoku.initialize(&client);
    display.firstPage();
    do
    {
      if(sudoku.initialized) sudoku.updateDisplay();
    }
    while (display.nextPage());
  }
}
